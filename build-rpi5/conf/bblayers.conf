## build-rpi5/conf/bblayers.conf
```bitbake
# POKY_BBLAYERS_CONF_VERSION is increased each time build/conf/bblayers.conf
# changes incompatibly
POKY_BBLAYERS_CONF_VERSION = "2"

BBPATH = "${TOPDIR}"
BBFILES ?= ""

BBLAYERS ?= " \
  /home/goyii/Documents/Yocto/yocto-ai-project/poky/meta \
  /home/goyii/Documents/Yocto/yocto-ai-project/poky/meta-poky \
  /home/goyii/Documents/Yocto/yocto-ai-project/poky/meta-yocto-bsp \
  /home/goyii/Documents/Yocto/yocto-ai-project/meta-raspberrypi \
  /home/goyii/Documents/Yocto/yocto-ai-project/meta-openembedded/meta-oe \
  /home/goyii/Documents/Yocto/yocto-ai-project/meta-openembedded/meta-python \
  /home/goyii/Documents/Yocto/yocto-ai-project/meta-openembedded/meta-networking \
  "
```

## meta-homeai/conf/layer.conf
```bitbake
# We have a conf and classes directory, add to BBPATH
BBPATH .= ":${LAYERDIR}"

# We have recipes-* directories, add to BBFILES
BBFILES += "${LAYERDIR}/recipes-*/*/*.bb \
            ${LAYERDIR}/recipes-*/*/*.bbappend"

BBFILE_COLLECTIONS += "meta-homeai"
BBFILE_PATTERN_meta-homeai = "^${LAYERDIR}/"
BBFILE_PRIORITY_meta-homeai = "6"

LAYERDEPENDS_meta-homeai = "core"
LAYERSERIES_COMPAT_meta-homeai = "kirkstone"
```
